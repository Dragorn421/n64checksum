D_A4000000 = 0xA4000000,
D_A4000040 = 0xA4000040,
D_BFC007F0 = 0xBFC007F0,
D_BFC007C0 = 0xBFC007C0,
D_A4800018 = 0xA4800018,
D_A4600014 = 0xA4600014,
D_A4600018 = 0xA4600018,
D_A460001C = 0xA460001C,
D_A4600020 = 0xA4600020,
D_A6000000 = 0xA6000000,
D_A4600000 = 0xA4600000,
D_A6000040 = 0xA6000040,
D_A410000C = 0xA410000C,
D_A4040018 = 0xA4040018;
D_A4600010 = 0xA4600010;
D_A440000C = 0xA440000C;
D_A4400024 = 0xA4400024;
D_A4400010 = 0xA4400010;
D_A4500000 = 0xA4500000;
D_A4500004 = 0xA4500004;
D_A4040010 = 0xA4040010;
D_BFC000D4 = 0xBFC000D4;
D_BFC0071C = 0xBFC0071C;
D_BFC007FC = 0xBFC007FC;

func_84000A84 = 0x84000A84;
func_84000A10 = 0x84000A10;
func_84000B44 = 0x84000B44;
D_A0000200 = 0xA0000200;
D_A430000C = 0xA430000C;
D_A450000C = 0xA450000C;
D_A4300000 = 0xA4300000;
D_B0000000 = 0xB0000000;
D_B0000010 = 0xB0000010;
D_B0000014 = 0xB0000014;
D_A4700000 = 0xA4700000;
D_A3F80008 = 0xA3F80008;
D_A3F80014 = 0xA3F80014;
D_A3F80004 = 0xA3F80004;
D_A0000000 = 0xA0000000;
D_A4300004 = 0xA4300004;
D_A3F0000C = 0xA3F0000C;
D_A3F00000 = 0xA3F00000;
D_A3F00024 = 0xA3F00024;
D_A3F00018 = 0xA3F00018;
func_8400087C = 0x8400087C;
jtbl_B0000008 = 0xB0000008;
D_A4600004 = 0xA4600004;
D_A460000C = 0xA460000C;
D_A404001C = 0xA404001C;
func_84000BD4 = 0x84000BD4;
D_A4700010 = 0xA4700010;
D_80000000 = 0x80000000;
D_A4000888 = 0xA4000888;
D_A4080000 = 0xA4080000;
D_A0000004 = 0xA0000004;
jtbl_80000004 = 0x80000004;
D_A3F8000C = 0xA3F8000C;

SECTIONS
{
    /*
     * the following error:
     * "non constant or forward reference address expression for section .text"
     * means "VRAM" is not set (pass --defsym VRAM=... to ld)
     */
    .text VRAM :
    {
        *(.text);
    }
}
